## areas/firmware/esp32s3-ota/main/Kconfig.projbuild
```kconfig
menu "Ludant firmware"

config LUDANT_FIRMWARE_VERSION
    string "Firmware version"
    default "0.1.0"
    help
        Version reported by the Device Info characteristic when the build
        does not provide another application version.

config LUDANT_OTA_WINDOW_SECONDS
    int "OTA permission window after boot (seconds)"
    range 1 3600
    default 120

config LUDANT_OTA_DEVELOPMENT_WINDOW
    bool "Allow timed OTA window (development only)"
    default n
    help
        When enabled, OTA is allowed during the configured boot window. Keep
        this disabled for production builds, which require the physical BOOT
        button confirmation.

config LUDANT_BOOT_VERSION
    string "Boot/runtime compatibility version"
    default "1.0.0"

config LUDANT_OTA_PUBLIC_KEY_DER_HEX
    string "Ed25519 public key DER encoded as hexadecimal"
    default ""
    help
        Release builds must inject the public key matching the private signing
        key. An empty key fails closed and rejects all OTA requests.

config LUDANT_BOOT_BUTTON_GPIO
    int "BOOT button GPIO"
    range 0 48
    default 0
    help
        The standard ESP32-S3 development-board BOOT button is GPIO0 and is
        active low. Holding it permits OTA outside the normal boot window.

endmenu
```

## areas/firmware/esp32s3-ota/sdkconfig.defaults
```kconfig
CONFIG_IDF_TARGET="esp32s3"
CONFIG_ESPTOOLPY_FLASHSIZE_4MB=y
CONFIG_ESPTOOLPY_FLASHSIZE="4MB"
CONFIG_PARTITION_TABLE_CUSTOM=y
CONFIG_PARTITION_TABLE_CUSTOM_FILENAME="partitions.csv"
CONFIG_PARTITION_TABLE_OFFSET=0x10000
CONFIG_BOOTLOADER_APP_ROLLBACK_ENABLE=y
CONFIG_BOOTLOADER_APP_ROLLBACK_CONFIRM_BY_APP=y
# Keep ROM download mode and user reflashing available. These product builds
# must never trigger irreversible eFuse provisioning on first boot.
# CONFIG_BOOTLOADER_APP_ANTI_ROLLBACK is not set
# CONFIG_SECURE_BOOT is not set
# CONFIG_SECURE_BOOT_V2_ENABLED is not set
# CONFIG_SECURE_DISABLE_ROM_DL_MODE is not set
# CONFIG_SECURE_ENABLE_SECURE_ROM_DL_MODE is not set
# CONFIG_SECURE_FLASH_ENC_ENABLED is not set
# CONFIG_SECURE_FLASH_ENCRYPTION_MODE_RELEASE is not set
# CONFIG_SECURE_FLASH_ENCRYPTION_MODE_DEVELOPMENT is not set
# CONFIG_FLASH_ENCRYPTION_ENABLED is not set
# CONFIG_FLASH_ENCRYPTION_INSECURE is not set
# CONFIG_FLASH_ENCRYPTION_UART_BOOTLOADER_ALLOW_ENCRYPT is not set
# CONFIG_SECURE_FLASH_UART_BOOTLOADER_ALLOW_ENC is not set
# CONFIG_SECURE_INSECURE_ALLOW_DL_MODE is not set
# CONFIG_NVS_ENCRYPTION is not set
# CONFIG_NVS_SEC_KEY_PROTECT_USING_FLASH_ENC is not set
CONFIG_LUDANT_OTA_PUBLIC_KEY_DER_HEX=""
CONFIG_BT_ENABLED=y
CONFIG_BT_NIMBLE_ENABLED=y
CONFIG_BT_NIMBLE_GAP_SERVICE=y
CONFIG_BT_NIMBLE_ROLE_PERIPHERAL=y
CONFIG_BT_NIMBLE_GATT_SERVER=y
CONFIG_BT_NIMBLE_MAX_CONNECTIONS=1
CONFIG_BT_NIMBLE_MAX_BONDS=1
CONFIG_BT_NIMBLE_NVS_PERSIST=y
CONFIG_BT_NIMBLE_ATT_PREFERRED_MTU=517
```
